## config/boards/shields/test_board/Kconfig.defconfig
```kconfig
# Copyright (c) 2022 The ZMK Contributors
# SPDX-License-Identifier: MIT

config ZMK_KEYBOARD_NAME
    default "Test Board"


config ZMK_DISPLAY

if ZMK_DISPLAY

config SSD1306
    default y

config I2C
    default y

config SSD1306_REVERSE_MODE
    default y

endif # ZMK_DISPLAY
```
